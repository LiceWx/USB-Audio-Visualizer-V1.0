#include "oled.h"
#include "cmsis_os.h"
#include "logo_bitmap.h"
#include <string.h>

/* ── Local DSP constants (normally from audio_dsp.h) ── */
#ifndef SPECTRO_BIN_WIDTH
#define SPECTRO_BIN_WIDTH   4U
#endif
#ifndef SPECTRO_GAP
#define SPECTRO_GAP         1U
#endif
#ifndef POOLED_BINS
#define POOLED_BINS         24U
#endif

/* ── 128x64 GRAM buffer ── */
static uint8_t OLED_GRAM[128][8];

/* ── Direct BSRR masks (all on GPIOA) ── */
/* PA4=DC, PA5=SCK, PA6=MOSI, PA7=RES */
#define OLED_DC_BIT    4U
#define OLED_SCK_BIT   5U
#define OLED_MOSI_BIT  6U
#define OLED_RES_BIT   7U

#define OLED_DC_Set()   (GPIOA->BSRR = (1U << OLED_DC_BIT))
#define OLED_DC_Clr()   (GPIOA->BSRR = (1U << (OLED_DC_BIT + 16U)))
#define OLED_RES_Set()  (GPIOA->BSRR = (1U << OLED_RES_BIT))
#define OLED_RES_Clr()  (GPIOA->BSRR = (1U << (OLED_RES_BIT + 16U)))
#define OLED_SCK_Set()  (GPIOA->BSRR = (1U << OLED_SCK_BIT))
#define OLED_SCK_Clr()  (GPIOA->BSRR = (1U << (OLED_SCK_BIT + 16U)))
#define OLED_MOSI_Set() (GPIOA->BSRR = (1U << OLED_MOSI_BIT))
#define OLED_MOSI_Clr() (GPIOA->BSRR = (1U << (OLED_MOSI_BIT + 16U)))

/* ── Software SPI byte write (bit-banged, BSRR direct) ── */
__attribute__((always_inline))
static inline void OLED_WR_Byte(uint8_t dat, uint8_t cmd)
{
  if (cmd) OLED_DC_Set();
  else     OLED_DC_Clr();

  /* Unrolled bit-bang with BSRR; ~3 stores/bit → ~60ns/bit → ~17 MHz */
  #define OLED_BIT(n)                                    \
    if (dat & (0x80U >> (n))) {                          \
      OLED_MOSI_Set(); __NOP();                          \
      OLED_SCK_Set();  __NOP();                          \
      OLED_SCK_Clr();                                    \
    } else {                                             \
      OLED_MOSI_Clr(); __NOP();                          \
      OLED_SCK_Set();  __NOP();                          \
      OLED_SCK_Clr();                                    \
    }

  OLED_BIT(0); OLED_BIT(1); OLED_BIT(2); OLED_BIT(3);
  OLED_BIT(4); OLED_BIT(5); OLED_BIT(6); OLED_BIT(7);

  #undef OLED_BIT

  OLED_DC_Set();
}

/* ── Update display from GRAM ── */
void OLED_Refresh(void)
{
  for (uint8_t page = 0; page < 8; page++)
  {
    OLED_WR_Byte(0xB0 + page, OLED_CMD);   /* page start address */
    OLED_WR_Byte(0x00, OLED_CMD);           /* column low  */
    OLED_WR_Byte(0x10, OLED_CMD);           /* column high */
    for (uint8_t col = 0; col < 128; col++)
    {
      OLED_WR_Byte(OLED_GRAM[col][page], OLED_DATA);
    }
  }
}

void OLED_Clear(void)
{
  memset(OLED_GRAM, 0, sizeof(OLED_GRAM));
  OLED_Refresh();
}

/* ── Draw point: mode 0=dark, 1=bright, 2=toggle (XOR) ── */
static void OLED_DrawPoint(uint8_t x, uint8_t y, uint8_t mode)
{
  uint8_t page = y >> 3;
  uint8_t bit  = 1 << (y & 0x07);
  if (mode == 2U)
    OLED_GRAM[x][page] ^= bit;          /* XOR toggle */
  else if (mode)
    OLED_GRAM[x][page] |= bit;
  else
    OLED_GRAM[x][page] &= ~bit;
}

/* ── 8x16 ASCII font ── */
const uint8_t asc2_1608[95][16] = {
  {0x00,0x00,0x00,0x00,0x00,0x00,0x00,0x00,0x00,0x00,0x00,0x00,0x00,0x00,0x00,0x00},/*" ",0*/
  {0x00,0x00,0x00,0xF8,0x00,0x00,0x00,0x00,0x00,0x00,0x00,0x33,0x30,0x00,0x00,0x00},/*"!",1*/
  {0x00,0x10,0x0C,0x06,0x10,0x0C,0x06,0x00,0x00,0x00,0x00,0x00,0x00,0x00,0x00,0x00},/*""",2*/
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  {0x00,0x06,0x01,0x01,0x02,0x02,0x04,0x04,0x00,0x00,0x00,0x00,0x00,0x00,0x00,0x00},/*"~",94*/
};

/* 6x8 font — forward declaration (defined below) */
extern const uint8_t asc2_0806[95][6];

void OLED_ShowChar(uint8_t x, uint8_t y, char chr, uint8_t size, uint8_t mode)
{
  uint8_t i, m, temp;
  uint8_t x0 = x, y0 = y;
  uint8_t idx = (uint8_t)(chr - ' ');
  if (idx > 94) return;

  uint8_t count = (size == 8U) ? 6U : size;   /* 6x8 font: 6 columns, not 8 */
  for (i = 0U; i < count; i++)
  {
    if (size == 8U)
      temp = asc2_0806[idx][i];
    else if (size == 16U)
      temp = asc2_1608[idx][i];
    else
      return;

    for (m = 0; m < 8; m++)
    {
      if (temp & 0x01)
        OLED_DrawPoint(x, y, mode);
      else if (mode != 2U)              /* mode=0/1 → draw background */
        OLED_DrawPoint(x, y, !mode);
      /* mode=2 (XOR): skip background pixels — let bar show through */
      temp >>= 1;
      y++;
    }
    x++;
    if ((size != 8) && ((x - x0) == size / 2))
    {
      x = x0;
      y0 += 8;
    }
    y = y0;
  }
}

/* 6x8 font (subset for small text) */
const uint8_t asc2_0806[95][6] = {
  {0x00,0x00,0x00,0x00,0x00,0x00},{0x00,0x00,0x00,0x2f,0x00,0x00},
  {0x00,0x00,0x07,0x00,0x07,0x00},{0x00,0x14,0x7f,0x14,0x7f,0x14},
  {0x00,0x24,0x2a,0x7f,0x2a,0x12},{0x00,0x62,0x64,0x08,0x13,0x23},
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  {0x00,0x44,0x64,0x54,0x4C,0x44},{0x14,0x14,0x14,0x14,0x14,0x14},
};

void OLED_ShowString(uint8_t x, uint8_t y, const char *str, uint8_t size, uint8_t mode)
{
  while (*str)
  {
    OLED_ShowChar(x, y, *str, size, mode);
    x += (size == 8) ? 6 : (size / 2);
    str++;
  }
}

static uint32_t OLED_Pow(uint8_t m, uint8_t n)
{
  uint32_t result = 1;
  while (n--) result *= m;
  return result;
}

void OLED_ShowNum(uint8_t x, uint8_t y, uint32_t num, uint8_t len, uint8_t size, uint8_t mode)
{
  uint8_t offset = (size == 8) ? 2 : 0;
  for (uint8_t t = 0; t < len; t++)
  {
    uint8_t digit = (uint8_t)((num / OLED_Pow(10, len - t - 1)) % 10);
    OLED_ShowChar(x + (size / 2 + offset) * t, y, (char)('0' + digit), size, mode);
  }
}

/* ── Progress bar: y0..y1 (vertical range), percent 0-100 fills left→right ── */
void OLED_DrawBar(uint8_t y0, uint8_t y1, uint8_t percent)
{
  uint8_t w = (uint8_t)(((uint16_t)percent * 128U) / 100U);
  if (w > 128) w = 128;

  for (uint8_t x = 0; x < 128; x++)
  {
    for (uint8_t y = y0; y <= y1; y++)
    {
      OLED_DrawPoint(x, y, (x < w) ? 1 : 0);
    }
  }
}

/* ── Time-domain waveform: draw count samples from buf[start], scaled to y0..y1 ── */
void OLED_DrawWave(const uint16_t *buf, uint16_t start, uint16_t count, uint8_t y0, uint8_t y1, uint8_t gain)
{
  uint8_t mid  = (y0 + y1) / 2U;
  uint8_t amp  = (y1 - y0) / 2U;   /* max pixels from center (half height) */
  float   step = (float)count / 128.0f;

  for (uint8_t col = 0; col < 128; col++)
  {
    uint16_t idx = start + (uint16_t)((float)col * step);
    if (idx >= start + count) idx = start + count - 1U;

    /* uint16 [0..65535] → signed, apply gain, clamp to ±amp */
    int16_t val  = (int16_t)(buf[idx] - 32768U);
    int32_t scaled = ((int32_t)val * (int32_t)gain) / 8;   /* gain/8 scaling */
    int16_t yoff = (int16_t)((scaled * (int32_t)amp) / 32768);
    int16_t y    = (int16_t)mid - yoff;

    if      (y < (int16_t)y0) y = y0;
    else if (y > (int16_t)y1) y = y1;

    OLED_DrawPoint(col, (uint8_t)y, 1);
  }
}

/* ── Spectrogram: 24 pooled bins, each 5px wide = 120 cols, centered ── */
/* mel_data[24] = per-bin magnitude, max_val = normalization max          */
void OLED_DrawSpectrogram(const float *mel_data, float max_val)
{
  float scale;
  if (max_val < 0.00001f)
    scale = 0.0f;
  else
    scale = 48.0f / max_val;  /* 48 pixels max height */

  /* Blue zone: pages 2..7 (rows 16..63) */
  for (uint8_t page = 2; page <= 7; page++)
  {
    uint8_t row_base = page * 8U;

    for (uint8_t col = 0; col < 128; col++)
    {
      uint8_t byte_val = 0U;

      /* Map column to bin: 4px bin + 1px gap, left-aligned */
      {
        uint16_t stride = SPECTRO_BIN_WIDTH + SPECTRO_GAP;
        uint16_t pos    = col % stride;
        if (pos >= SPECTRO_BIN_WIDTH)
        {
          OLED_GRAM[col][page] = 0U;  /* gap column */
          continue;
        }
        uint16_t bin = (uint16_t)(col / stride);
        if (bin >= POOLED_BINS)
        {
          OLED_GRAM[col][page] = 0U;
          continue;
        }

        float hf = mel_data[bin] * scale;
        uint8_t h;
        if (hf > 48.0f) h = 48U;
        else if (hf < 0.0f) h = 0U;
        else h = (uint8_t)hf;

        int16_t bar_top = (int16_t)(63U - h + 1U);
        if (bar_top < 16) bar_top = 16;
        if (bar_top > 64) bar_top = 64;

        for (uint8_t bit = 0; bit < 8; bit++)
        {
          uint8_t row = row_base + bit;
          if (row >= (uint8_t)bar_top && row <= 63U)
            byte_val |= (1U << bit);
        }

        OLED_GRAM[col][page] = byte_val;
      }
    }
  }
}

/* ── Onset Detection Function bar chart: 128 columns, filled from bottom ── */
void OLED_DrawODFBars(const float *odf, float max_val)
{
  float scale;
  if (max_val < 0.00001f)
    scale = 0.0f;
  else
    scale = 48.0f / max_val;  /* 48 pixels max in blue zone */

  for (uint8_t page = 2; page <= 7; page++)
  {
    uint8_t row_base = page * 8U;

    for (uint8_t col = 0; col < 128; col++)
    {
      float hf = odf[col] * scale;
      uint8_t h;
      if (hf > 48.0f) h = 48U;
      else if (hf < 1.0f) h = 1U;   /* minimum 1 px — zero is still visible */
      else h = (uint8_t)hf;

      int16_t bar_top = (int16_t)(63U - h + 1U);
      if (bar_top < 16) bar_top = 16;
      if (bar_top > 64) bar_top = 64;

      uint8_t byte_val = 0U;
      for (uint8_t bit = 0; bit < 8; bit++)
      {
        uint8_t row = row_base + bit;
        if (row >= (uint8_t)bar_top && row <= 63U)
          byte_val |= (1U << bit);
      }

      OLED_GRAM[col][page] = byte_val;
    }
  }
}

/* ── Draw external bitmap into GRAM at specified pages ── */
void OLED_DrawBitmap(uint8_t start_page, uint8_t num_pages, const uint8_t bitmap[][6])
{
  for (uint8_t page = 0; page < num_pages; page++)
  {
    for (uint8_t col = 0; col < 128; col++)
    {
      OLED_GRAM[col][start_page + page] = bitmap[col][page];
    }
  }
}

void OLED_Init(void)
{
  /* Set initial pin states (pins are already GPIO outputs from MX_GPIO_Init) */
  OLED_SCK_Clr();
  OLED_MOSI_Clr();
  OLED_DC_Set();

  OLED_RES_Clr();
  osDelay(10);
  OLED_RES_Set();
  osDelay(10);

  OLED_WR_Byte(0xAE, OLED_CMD); /* display off */
  OLED_WR_Byte(0x00, OLED_CMD);
  OLED_WR_Byte(0x10, OLED_CMD);
  OLED_WR_Byte(0x40, OLED_CMD);
  OLED_WR_Byte(0x81, OLED_CMD); /* contrast */
  OLED_WR_Byte(0xCF, OLED_CMD);
  OLED_WR_Byte(0xA1, OLED_CMD); /* segment remap */
  OLED_WR_Byte(0xC8, OLED_CMD); /* COM scan direction */
  OLED_WR_Byte(0xA6, OLED_CMD); /* normal display */
  OLED_WR_Byte(0xA8, OLED_CMD); /* multiplex */
  OLED_WR_Byte(0x3F, OLED_CMD); /* 1/64 duty */
  OLED_WR_Byte(0xD3, OLED_CMD); /* display offset */
  OLED_WR_Byte(0x00, OLED_CMD);
  OLED_WR_Byte(0xD5, OLED_CMD); /* clock div */
  OLED_WR_Byte(0x80, OLED_CMD);
  OLED_WR_Byte(0xD9, OLED_CMD); /* pre-charge */
  OLED_WR_Byte(0xF1, OLED_CMD);
  OLED_WR_Byte(0xDA, OLED_CMD); /* COM pins */
  OLED_WR_Byte(0x12, OLED_CMD);
  OLED_WR_Byte(0xDB, OLED_CMD); /* VCOMH */
  OLED_WR_Byte(0x40, OLED_CMD);
  OLED_WR_Byte(0x20, OLED_CMD); /* addressing mode */
  OLED_WR_Byte(0x02, OLED_CMD); /* page addressing */
  OLED_WR_Byte(0x8D, OLED_CMD); /* charge pump */
  OLED_WR_Byte(0x14, OLED_CMD);
  OLED_WR_Byte(0xA4, OLED_CMD);
  OLED_WR_Byte(0xA6, OLED_CMD);
  OLED_Clear();
  OLED_WR_Byte(0xAF, OLED_CMD); /* display on */
}

/* ── Pre-RTOS test: same init but uses HAL_Delay ── */
void OLED_PreRTOS_Test(void)
{
  OLED_SCK_Clr();
  OLED_MOSI_Clr();
  OLED_DC_Set();

  OLED_RES_Clr();
  HAL_Delay(50);
  OLED_RES_Set();
  HAL_Delay(50);

  OLED_WR_Byte(0xAE, OLED_CMD); OLED_WR_Byte(0x00, OLED_CMD);
  OLED_WR_Byte(0x10, OLED_CMD); OLED_WR_Byte(0x40, OLED_CMD);
  OLED_WR_Byte(0x81, OLED_CMD); OLED_WR_Byte(0xCF, OLED_CMD);
  OLED_WR_Byte(0xA1, OLED_CMD); OLED_WR_Byte(0xC8, OLED_CMD);
  OLED_WR_Byte(0xA6, OLED_CMD); OLED_WR_Byte(0xA8, OLED_CMD);
  OLED_WR_Byte(0x3F, OLED_CMD); OLED_WR_Byte(0xD3, OLED_CMD);
  OLED_WR_Byte(0x00, OLED_CMD); OLED_WR_Byte(0xD5, OLED_CMD);
  OLED_WR_Byte(0x80, OLED_CMD); OLED_WR_Byte(0xD9, OLED_CMD);
  OLED_WR_Byte(0xF1, OLED_CMD); OLED_WR_Byte(0xDA, OLED_CMD);
  OLED_WR_Byte(0x12, OLED_CMD); OLED_WR_Byte(0xDB, OLED_CMD);
  OLED_WR_Byte(0x40, OLED_CMD); OLED_WR_Byte(0x20, OLED_CMD);
  OLED_WR_Byte(0x02, OLED_CMD); OLED_WR_Byte(0x8D, OLED_CMD);
  OLED_WR_Byte(0x14, OLED_CMD); OLED_WR_Byte(0xA4, OLED_CMD);
  OLED_WR_Byte(0xA6, OLED_CMD); OLED_Clear();
  OLED_WR_Byte(0xAF, OLED_CMD);

  OLED_ShowString(37, 0, "USB Audio", 8, 1);
  OLED_ShowString(34, 8, "Visualizer", 8, 1);
  OLED_DrawBitmap(2, 6, logo_bitmap);

  /* Invert logo area: pages 2-7 */
  for (uint8_t page = 2; page <= 7; page++)
    for (uint8_t col = 0; col < 128; col++)
      OLED_GRAM[col][page] ^= 0xFFU;

  OLED_Refresh();
  HAL_Delay(600);
}
